## config/west.yml
```yaml
manifest:
  remotes:
    - name: zmkfirmware
      url-base: https://github.com/zmkfirmware
  projects:
    - name: alu40-module
      url: https://github.com/polarityworks/zmk-config-alu40
      revision: main
      clone-depth: 1
    - name: zmk
      remote: zmkfirmware
      # revision: main
      # see https://github.com/nickcoutsos/keymap-editor/discussions/347
      # https://zmk.dev/blog/2025/12/09/zephyr-4-1#switching-to-the-previous-release
      # => check build.yml aswell
      revision: v0.3
      import: app/west.yml
  self:
    path: config
```
